## package/dvkm/Config.in
```kconfig
config BR2_PACKAGE_DVKM
	bool "dvkm"
	# uses fork()
	depends on BR2_LINUX_KERNEL
	help
	  Damn Vulnerable Kernel Module for kernel fuzzing.

	  https://github.com/hardik05/Damn_Vulnerable_Kernel_Module
```
